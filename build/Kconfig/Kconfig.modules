## build/Kconfig/soc/Kconfig.sysbuild
```kconfig
# Load Sysbuild SoC Kconfig descriptions.
osource "/home/rodrigo/my-workspace/zephyr/soc/xlnx/zynqmp/Kconfig.sysbuild"
osource "/home/rodrigo/my-workspace/zephyr/soc/xlnx/zynq7000/Kconfig.sysbuild"
osource "/home/rodrigo/my-workspace/zephyr/soc/xlnx/versalnet/Kconfig.sysbuild"
osource "/home/rodrigo/my-workspace/zephyr/soc/xlnx/versal2/Kconfig.sysbuild"
osource "/home/rodrigo/my-workspace/zephyr/soc/xlnx/versal/Kconfig.sysbuild"
osource "/home/rodrigo/my-workspace/zephyr/soc/xen/Kconfig.sysbuild"
osource "/home/rodrigo/my-workspace/zephyr/soc/wch/ch32v/Kconfig.sysbuild"
osource "/home/rodrigo/my-workspace/zephyr/soc/ti/simplelink/Kconfig.sysbuild"
osource "/home/rodrigo/my-workspace/zephyr/soc/ti/mspm0/Kconfig.sysbuild"
osource "/home/rodrigo/my-workspace/zephyr/soc/ti/lm3s6965/Kconfig.sysbuild"
osource "/home/rodrigo/my-workspace/zephyr/soc/ti/k3/Kconfig.sysbuild"
osource "/home/rodrigo/my-workspace/zephyr/soc/telink/tlsr/Kconfig.sysbuild"
osource "/home/rodrigo/my-workspace/zephyr/soc/syna/sr100/Kconfig.sysbuild"
osource "/home/rodrigo/my-workspace/zephyr/soc/starfive/jh71xx/Kconfig.sysbuild"
osource "/home/rodrigo/my-workspace/zephyr/soc/st/stm32/Kconfig.sysbuild"
osource "/home/rodrigo/my-workspace/zephyr/soc/snps/qemu_arc/Kconfig.sysbuild"
osource "/home/rodrigo/my-workspace/zephyr/soc/snps/nsim/arc_v/Kconfig.sysbuild"
osource "/home/rodrigo/my-workspace/zephyr/soc/snps/nsim/arc_classic/Kconfig.sysbuild"
osource "/home/rodrigo/my-workspace/zephyr/soc/snps/hsdk4xd/Kconfig.sysbuild"
osource "/home/rodrigo/my-workspace/zephyr/soc/snps/hsdk/Kconfig.sysbuild"
osource "/home/rodrigo/my-workspace/zephyr/soc/snps/emsk/Kconfig.sysbuild"
osource "/home/rodrigo/my-workspace/zephyr/soc/snps/emsdp/Kconfig.sysbuild"
osource "/home/rodrigo/my-workspace/zephyr/soc/snps/arc_iot/Kconfig.sysbuild"
osource "/home/rodrigo/my-workspace/zephyr/soc/silabs/Kconfig.sysbuild"
osource "/home/rodrigo/my-workspace/zephyr/soc/sifli/sf32/Kconfig.sysbuild"
osource "/home/rodrigo/my-workspace/zephyr/soc/sifive/sifive_freedom/Kconfig.sysbuild"
osource "/home/rodrigo/my-workspace/zephyr/soc/sensry/Kconfig.sysbuild"
osource "/home/rodrigo/my-workspace/zephyr/soc/rockchip/Kconfig.sysbuild"
osource "/home/rodrigo/my-workspace/zephyr/soc/renode/riscv_virtual/Kconfig.sysbuild"
osource "/home/rodrigo/my-workspace/zephyr/soc/renode/cortex_r8_virtual/Kconfig.sysbuild"
osource "/home/rodrigo/my-workspace/zephyr/soc/renesas/smartbond/Kconfig.sysbuild"
osource "/home/rodrigo/my-workspace/zephyr/soc/renesas/rz/Kconfig.sysbuild"
osource "/home/rodrigo/my-workspace/zephyr/soc/renesas/rx/Kconfig.sysbuild"
osource "/home/rodrigo/my-workspace/zephyr/soc/renesas/rcar/Kconfig.sysbuild"
osource "/home/rodrigo/my-workspace/zephyr/soc/renesas/ra/Kconfig.sysbuild"
osource "/home/rodrigo/my-workspace/zephyr/soc/realtek/fingerprint/Kconfig.sysbuild"
osource "/home/rodrigo/my-workspace/zephyr/soc/realtek/ec/Kconfig.sysbuild"
osource "/home/rodrigo/my-workspace/zephyr/soc/realtek/bee/Kconfig.sysbuild"
osource "/home/rodrigo/my-workspace/zephyr/soc/realtek/ameba/Kconfig.sysbuild"
osource "/home/rodrigo/my-workspace/zephyr/soc/raspberrypi/rpi_pico/Kconfig.sysbuild"
osource "/home/rodrigo/my-workspace/zephyr/soc/quicklogic/eos_s3/Kconfig.sysbuild"
osource "/home/rodrigo/my-workspace/zephyr/soc/qemu/virt_riscv/Kconfig.sysbuild"
osource "/home/rodrigo/my-workspace/zephyr/soc/qemu/or1k/Kconfig.sysbuild"
osource "/home/rodrigo/my-workspace/zephyr/soc/qemu/malta/Kconfig.sysbuild"
osource "/home/rodrigo/my-workspace/zephyr/soc/openisa/rv32m1/Kconfig.sysbuild"
osource "/home/rodrigo/my-workspace/zephyr/soc/openhwgroup/cva6/Kconfig.sysbuild"
osource "/home/rodrigo/my-workspace/zephyr/soc/oct/osd32mp15x/Kconfig.sysbuild"
osource "/home/rodrigo/my-workspace/zephyr/soc/nxp/s32/Kconfig.sysbuild"
osource "/home/rodrigo/my-workspace/zephyr/soc/nxp/rw/Kconfig.sysbuild"
osource "/home/rodrigo/my-workspace/zephyr/soc/nxp/mcx/Kconfig.sysbuild"
osource "/home/rodrigo/my-workspace/zephyr/soc/nxp/lpc/Kconfig.sysbuild"
osource "/home/rodrigo/my-workspace/zephyr/soc/nxp/layerscape/Kconfig.sysbuild"
osource "/home/rodrigo/my-workspace/zephyr/soc/nxp/kinetis/Kconfig.sysbuild"
osource "/home/rodrigo/my-workspace/zephyr/soc/nxp/imxrt/Kconfig.sysbuild"
osource "/home/rodrigo/my-workspace/zephyr/soc/nxp/imx/Kconfig.sysbuild"
osource "/home/rodrigo/my-workspace/zephyr/soc/nuvoton/numicro/Kconfig.sysbuild"
osource "/home/rodrigo/my-workspace/zephyr/soc/nuvoton/numaker/Kconfig.sysbuild"
osource "/home/rodrigo/my-workspace/zephyr/soc/nuvoton/npcx/Kconfig.sysbuild"
osource "/home/rodrigo/my-workspace/zephyr/soc/nuvoton/npcm/Kconfig.sysbuild"
osource "/home/rodrigo/my-workspace/zephyr/soc/nordic/Kconfig.sysbuild"
osource "/home/rodrigo/my-workspace/zephyr/soc/neorv32/Kconfig.sysbuild"
osource "/home/rodrigo/my-workspace/zephyr/soc/native/inf_clock/Kconfig.sysbuild"
osource "/home/rodrigo/my-workspace/zephyr/soc/microchip/sam/sama7/Kconfig.sysbuild"
osource "/home/rodrigo/my-workspace/zephyr/soc/microchip/sam/sam_d5x_e5x/Kconfig.sysbuild"
osource "/home/rodrigo/my-workspace/zephyr/soc/microchip/pic64/Kconfig.sysbuild"
osource "/home/rodrigo/my-workspace/zephyr/soc/microchip/pic32c/pic32cz_ca/Kconfig.sysbuild"
osource "/home/rodrigo/my-workspace/zephyr/soc/microchip/pic32c/pic32cx_sg/Kconfig.sysbuild"
osource "/home/rodrigo/my-workspace/zephyr/soc/microchip/pic32c/pic32cm_sg_gc/Kconfig.sysbuild"
osource "/home/rodrigo/my-workspace/zephyr/soc/microchip/pic32c/pic32cm_pl/Kconfig.sysbuild"
osource "/home/rodrigo/my-workspace/zephyr/soc/microchip/pic32c/pic32cm_jh/Kconfig.sysbuild"
osource "/home/rodrigo/my-workspace/zephyr/soc/microchip/pic32c/pic32ck_sg_gc/Kconfig.sysbuild"
osource "/home/rodrigo/my-workspace/zephyr/soc/microchip/miv/Kconfig.sysbuild"
osource "/home/rodrigo/my-workspace/zephyr/soc/microchip/mec/Kconfig.sysbuild"
osource "/home/rodrigo/my-workspace/zephyr/soc/mediatek/mt8xxx/Kconfig.sysbuild"
osource "/home/rodrigo/my-workspace/zephyr/soc/lowrisc/opentitan/Kconfig.sysbuild"
osource "/home/rodrigo/my-workspace/zephyr/soc/litex/Kconfig.sysbuild"
osource "/home/rodrigo/my-workspace/zephyr/soc/ite/ec/Kconfig.sysbuild"
osource "/home/rodrigo/my-workspace/zephyr/soc/intel/wildcat_lake/Kconfig.sysbuild"
osource "/home/rodrigo/my-workspace/zephyr/soc/intel/raptor_lake/Kconfig.sysbuild"
osource "/home/rodrigo/my-workspace/zephyr/soc/intel/panther_lake/Kconfig.sysbuild"
osource "/home/rodrigo/my-workspace/zephyr/soc/intel/lakemont/Kconfig.sysbuild"
osource "/home/rodrigo/my-workspace/zephyr/soc/intel/intel_socfpga_std/Kconfig.sysbuild"
osource "/home/rodrigo/my-workspace/zephyr/soc/intel/intel_socfpga/Kconfig.sysbuild"
osource "/home/rodrigo/my-workspace/zephyr/soc/intel/intel_niosv/Kconfig.sysbuild"
osource "/home/rodrigo/my-workspace/zephyr/soc/intel/intel_ish/Kconfig.sysbuild"
osource "/home/rodrigo/my-workspace/zephyr/soc/intel/intel_adsp/Kconfig.sysbuild"
osource "/home/rodrigo/my-workspace/zephyr/soc/intel/elkhart_lake/Kconfig.sysbuild"
osource "/home/rodrigo/my-workspace/zephyr/soc/intel/atom/Kconfig.sysbuild"
osource "/home/rodrigo/my-workspace/zephyr/soc/intel/apollo_lake/Kconfig.sysbuild"
osource "/home/rodrigo/my-workspace/zephyr/soc/intel/alder_lake/Kconfig.sysbuild"
osource "/home/rodrigo/my-workspace/zephyr/soc/infineon/psoc4/Kconfig.sysbuild"
osource "/home/rodrigo/my-workspace/zephyr/soc/infineon/edge/Kconfig.sysbuild"
osource "/home/rodrigo/my-workspace/zephyr/soc/infineon/cat3/Kconfig.sysbuild"
osource "/home/rodrigo/my-workspace/zephyr/soc/infineon/cat1c/Kconfig.sysbuild"
osource "/home/rodrigo/my-workspace/zephyr/soc/infineon/cat1b/Kconfig.sysbuild"
osource "/home/rodrigo/my-workspace/zephyr/soc/infineon/cat1a/Kconfig.sysbuild"
osource "/home/rodrigo/my-workspace/zephyr/soc/gd/gd32/Kconfig.sysbuild"
osource "/home/rodrigo/my-workspace/zephyr/soc/gaisler/leon3/Kconfig.sysbuild"
osource "/home/rodrigo/my-workspace/zephyr/soc/gaisler/gr716a/Kconfig.sysbuild"
osource "/home/rodrigo/my-workspace/zephyr/soc/focaltech/Kconfig.sysbuild"
osource "/home/rodrigo/my-workspace/zephyr/soc/espressif/Kconfig.sysbuild"
osource "/home/rodrigo/my-workspace/zephyr/soc/ene/kb1200/Kconfig.sysbuild"
osource "/home/rodrigo/my-workspace/zephyr/soc/ene/kb106x/Kconfig.sysbuild"
osource "/home/rodrigo/my-workspace/zephyr/soc/elan/em32f967/Kconfig.sysbuild"
osource "/home/rodrigo/my-workspace/zephyr/soc/egis/Kconfig.sysbuild"
osource "/home/rodrigo/my-workspace/zephyr/soc/efinix/sapphire/Kconfig.sysbuild"
osource "/home/rodrigo/my-workspace/zephyr/soc/cdns/xtensa_sample_controller/Kconfig.sysbuild"
osource "/home/rodrigo/my-workspace/zephyr/soc/cdns/swerv/Kconfig.sysbuild"
osource "/home/rodrigo/my-workspace/zephyr/soc/cdns/sample_controller32/Kconfig.sysbuild"
osource "/home/rodrigo/my-workspace/zephyr/soc/cdns/dc233c/Kconfig.sysbuild"
osource "/home/rodrigo/my-workspace/zephyr/soc/brcm/bcmvk/Kconfig.sysbuild"
osource "/home/rodrigo/my-workspace/zephyr/soc/brcm/bcm2712/Kconfig.sysbuild"
osource "/home/rodrigo/my-workspace/zephyr/soc/brcm/bcm2711/Kconfig.sysbuild"
osource "/home/rodrigo/my-workspace/zephyr/soc/blackberry/qnxhv_vm/Kconfig.sysbuild"
osource "/home/rodrigo/my-workspace/zephyr/soc/bflb/Kconfig.sysbuild"
osource "/home/rodrigo/my-workspace/zephyr/soc/atmel/sam0/Kconfig.sysbuild"
osource "/home/rodrigo/my-workspace/zephyr/soc/atmel/sam/Kconfig.sysbuild"
osource "/home/rodrigo/my-workspace/zephyr/soc/aspeed/Kconfig.sysbuild"
osource "/home/rodrigo/my-workspace/zephyr/soc/arm/Kconfig.sysbuild"
osource "/home/rodrigo/my-workspace/zephyr/soc/arm/beetle/Kconfig.sysbuild"
osource "/home/rodrigo/my-workspace/zephyr/soc/antmicro/myra/Kconfig.sysbuild"
osource "/home/rodrigo/my-workspace/zephyr/soc/andestech/Kconfig.sysbuild"
osource "/home/rodrigo/my-workspace/zephyr/soc/amd/acp_7_x/Kconfig.sysbuild"
osource "/home/rodrigo/my-workspace/zephyr/soc/amd/acp_7_0/Kconfig.sysbuild"
osource "/home/rodrigo/my-workspace/zephyr/soc/amd/acp_6_0/Kconfig.sysbuild"
osource "/home/rodrigo/my-workspace/zephyr/soc/ambiq/Kconfig.sysbuild"
osource "/home/rodrigo/my-workspace/zephyr/soc/allwinner/sun8i_h3/Kconfig.sysbuild"
osource "/home/rodrigo/my-workspace/zephyr/soc/allwinner/sun50i_h618/Kconfig.sysbuild"
osource "/home/rodrigo/my-workspace/zephyr/soc/alif/ensemble/Kconfig.sysbuild"
osource "/home/rodrigo/my-workspace/zephyr/soc/alif/balletto/Kconfig.sysbuild"
osource "/home/rodrigo/my-workspace/zephyr/soc/aesc/Kconfig.sysbuild"
osource "/home/rodrigo/my-workspace/zephyr/soc/adi/max32/Kconfig.sysbuild"
```
