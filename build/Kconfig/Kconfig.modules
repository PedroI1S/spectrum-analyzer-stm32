## build/Kconfig/Kconfig.modules
```kconfig
menu "example-application (/home/rodrigo/my-workspace/example-application)"
osource "/home/rodrigo/my-workspace/example-application/Kconfig"
config ZEPHYR_EXAMPLE_APPLICATION_MODULE
	bool
	default y
endmenu
menu "cmsis_6 (/home/rodrigo/my-workspace/modules/hal/cmsis_6)"
osource "$(ZEPHYR_CMSIS_6_KCONFIG)"
config ZEPHYR_CMSIS_6_MODULE
	bool
	default y
endmenu
menu "hal_nordic (/home/rodrigo/my-workspace/modules/hal/nordic)"
osource "$(ZEPHYR_HAL_NORDIC_KCONFIG)"
config ZEPHYR_HAL_NORDIC_MODULE
	bool
	default y

config ZEPHYR_HAL_NORDIC_MODULE_BLOBS
	bool
endmenu
config ZEPHYR_HAL_STM32_MODULE
	bool
	default y

config ZEPHYR_HAL_STM32_MODULE_BLOBS
	bool
```

## build/Kconfig/Kconfig.shield.defconfig
```kconfig
osource "/home/rodrigo/my-workspace/example-application/boards/shields/*/Kconfig.defconfig"
```

## build/Kconfig/arch/Kconfig
```kconfig
# Load Zephyr Arch Kconfig descriptions.
osource "/home/rodrigo/my-workspace/zephyr/arch/rx/Kconfig"
osource "/home/rodrigo/my-workspace/zephyr/arch/x86/Kconfig"
osource "/home/rodrigo/my-workspace/zephyr/arch/xtensa/Kconfig"
osource "/home/rodrigo/my-workspace/zephyr/arch/sparc/Kconfig"
osource "/home/rodrigo/my-workspace/zephyr/arch/riscv/Kconfig"
osource "/home/rodrigo/my-workspace/zephyr/arch/posix/Kconfig"
osource "/home/rodrigo/my-workspace/zephyr/arch/openrisc/Kconfig"
osource "/home/rodrigo/my-workspace/zephyr/arch/mips/Kconfig"
osource "/home/rodrigo/my-workspace/zephyr/arch/arm64/Kconfig"
osource "/home/rodrigo/my-workspace/zephyr/arch/arm/Kconfig"
osource "/home/rodrigo/my-workspace/zephyr/arch/arc/Kconfig"
```

## build/Kconfig/boards/Kconfig.custom_plank
```kconfig
# Load board Kconfig descriptions.
osource "/home/rodrigo/my-workspace/example-application/boards/vendor/custom_plank/Kconfig.custom_plank"
```

## build/Kconfig/boards/Kconfig.defconfig
```kconfig
# Load Zephyr board defconfig descriptions.
osource "/home/rodrigo/my-workspace/example-application/boards/vendor/custom_plank/Kconfig.defconfig"
```

## build/Kconfig/soc/Kconfig
```kconfig
# Load Zephyr SoC Kconfig descriptions.
osource "/home/rodrigo/my-workspace/zephyr/soc/xlnx/zynqmp/Kconfig"
osource "/home/rodrigo/my-workspace/zephyr/soc/xlnx/zynq7000/Kconfig"
osource "/home/rodrigo/my-workspace/zephyr/soc/xlnx/versalnet/Kconfig"
osource "/home/rodrigo/my-workspace/zephyr/soc/xlnx/versal2/Kconfig"
osource "/home/rodrigo/my-workspace/zephyr/soc/xlnx/versal/Kconfig"
osource "/home/rodrigo/my-workspace/zephyr/soc/xen/Kconfig"
osource "/home/rodrigo/my-workspace/zephyr/soc/wch/ch32v/Kconfig"
osource "/home/rodrigo/my-workspace/zephyr/soc/ti/simplelink/Kconfig"
osource "/home/rodrigo/my-workspace/zephyr/soc/ti/mspm0/Kconfig"
osource "/home/rodrigo/my-workspace/zephyr/soc/ti/lm3s6965/Kconfig"
osource "/home/rodrigo/my-workspace/zephyr/soc/ti/k3/Kconfig"
osource "/home/rodrigo/my-workspace/zephyr/soc/telink/tlsr/Kconfig"
osource "/home/rodrigo/my-workspace/zephyr/soc/syna/sr100/Kconfig"
osource "/home/rodrigo/my-workspace/zephyr/soc/starfive/jh71xx/Kconfig"
osource "/home/rodrigo/my-workspace/zephyr/soc/st/stm32/Kconfig"
osource "/home/rodrigo/my-workspace/zephyr/soc/snps/qemu_arc/Kconfig"
osource "/home/rodrigo/my-workspace/zephyr/soc/snps/nsim/arc_v/Kconfig"
osource "/home/rodrigo/my-workspace/zephyr/soc/snps/nsim/arc_classic/Kconfig"
osource "/home/rodrigo/my-workspace/zephyr/soc/snps/hsdk4xd/Kconfig"
osource "/home/rodrigo/my-workspace/zephyr/soc/snps/hsdk/Kconfig"
osource "/home/rodrigo/my-workspace/zephyr/soc/snps/emsk/Kconfig"
osource "/home/rodrigo/my-workspace/zephyr/soc/snps/emsdp/Kconfig"
osource "/home/rodrigo/my-workspace/zephyr/soc/snps/arc_iot/Kconfig"
osource "/home/rodrigo/my-workspace/zephyr/soc/silabs/Kconfig"
osource "/home/rodrigo/my-workspace/zephyr/soc/sifli/sf32/Kconfig"
osource "/home/rodrigo/my-workspace/zephyr/soc/sifive/sifive_freedom/Kconfig"
osource "/home/rodrigo/my-workspace/zephyr/soc/sensry/Kconfig"
osource "/home/rodrigo/my-workspace/zephyr/soc/rockchip/Kconfig"
osource "/home/rodrigo/my-workspace/zephyr/soc/renode/riscv_virtual/Kconfig"
osource "/home/rodrigo/my-workspace/zephyr/soc/renode/cortex_r8_virtual/Kconfig"
osource "/home/rodrigo/my-workspace/zephyr/soc/renesas/smartbond/Kconfig"
osource "/home/rodrigo/my-workspace/zephyr/soc/renesas/rz/Kconfig"
osource "/home/rodrigo/my-workspace/zephyr/soc/renesas/rx/Kconfig"
osource "/home/rodrigo/my-workspace/zephyr/soc/renesas/rcar/Kconfig"
osource "/home/rodrigo/my-workspace/zephyr/soc/renesas/ra/Kconfig"
osource "/home/rodrigo/my-workspace/zephyr/soc/realtek/fingerprint/Kconfig"
osource "/home/rodrigo/my-workspace/zephyr/soc/realtek/ec/Kconfig"
osource "/home/rodrigo/my-workspace/zephyr/soc/realtek/bee/Kconfig"
osource "/home/rodrigo/my-workspace/zephyr/soc/realtek/ameba/Kconfig"
osource "/home/rodrigo/my-workspace/zephyr/soc/raspberrypi/rpi_pico/Kconfig"
osource "/home/rodrigo/my-workspace/zephyr/soc/quicklogic/eos_s3/Kconfig"
osource "/home/rodrigo/my-workspace/zephyr/soc/qemu/virt_riscv/Kconfig"
osource "/home/rodrigo/my-workspace/zephyr/soc/qemu/or1k/Kconfig"
osource "/home/rodrigo/my-workspace/zephyr/soc/qemu/malta/Kconfig"
osource "/home/rodrigo/my-workspace/zephyr/soc/openisa/rv32m1/Kconfig"
osource "/home/rodrigo/my-workspace/zephyr/soc/openhwgroup/cva6/Kconfig"
osource "/home/rodrigo/my-workspace/zephyr/soc/oct/osd32mp15x/Kconfig"
osource "/home/rodrigo/my-workspace/zephyr/soc/nxp/s32/Kconfig"
osource "/home/rodrigo/my-workspace/zephyr/soc/nxp/rw/Kconfig"
osource "/home/rodrigo/my-workspace/zephyr/soc/nxp/mcx/Kconfig"
osource "/home/rodrigo/my-workspace/zephyr/soc/nxp/lpc/Kconfig"
osource "/home/rodrigo/my-workspace/zephyr/soc/nxp/layerscape/Kconfig"
osource "/home/rodrigo/my-workspace/zephyr/soc/nxp/kinetis/Kconfig"
osource "/home/rodrigo/my-workspace/zephyr/soc/nxp/imxrt/Kconfig"
osource "/home/rodrigo/my-workspace/zephyr/soc/nxp/imx/Kconfig"
osource "/home/rodrigo/my-workspace/zephyr/soc/nuvoton/numicro/Kconfig"
osource "/home/rodrigo/my-workspace/zephyr/soc/nuvoton/numaker/Kconfig"
osource "/home/rodrigo/my-workspace/zephyr/soc/nuvoton/npcx/Kconfig"
osource "/home/rodrigo/my-workspace/zephyr/soc/nuvoton/npcm/Kconfig"
osource "/home/rodrigo/my-workspace/zephyr/soc/nordic/Kconfig"
osource "/home/rodrigo/my-workspace/zephyr/soc/neorv32/Kconfig"
osource "/home/rodrigo/my-workspace/zephyr/soc/native/inf_clock/Kconfig"
osource "/home/rodrigo/my-workspace/zephyr/soc/microchip/sam/sama7/Kconfig"
osource "/home/rodrigo/my-workspace/zephyr/soc/microchip/sam/sam_d5x_e5x/Kconfig"
osource "/home/rodrigo/my-workspace/zephyr/soc/microchip/pic64/Kconfig"
osource "/home/rodrigo/my-workspace/zephyr/soc/microchip/pic32c/pic32cz_ca/Kconfig"
osource "/home/rodrigo/my-workspace/zephyr/soc/microchip/pic32c/pic32cx_sg/Kconfig"
osource "/home/rodrigo/my-workspace/zephyr/soc/microchip/pic32c/pic32cm_sg_gc/Kconfig"
osource "/home/rodrigo/my-workspace/zephyr/soc/microchip/pic32c/pic32cm_pl/Kconfig"
osource "/home/rodrigo/my-workspace/zephyr/soc/microchip/pic32c/pic32cm_jh/Kconfig"
osource "/home/rodrigo/my-workspace/zephyr/soc/microchip/pic32c/pic32ck_sg_gc/Kconfig"
osource "/home/rodrigo/my-workspace/zephyr/soc/microchip/miv/Kconfig"
osource "/home/rodrigo/my-workspace/zephyr/soc/microchip/mec/Kconfig"
osource "/home/rodrigo/my-workspace/zephyr/soc/mediatek/mt8xxx/Kconfig"
osource "/home/rodrigo/my-workspace/zephyr/soc/lowrisc/opentitan/Kconfig"
osource "/home/rodrigo/my-workspace/zephyr/soc/litex/Kconfig"
osource "/home/rodrigo/my-workspace/zephyr/soc/ite/ec/Kconfig"
osource "/home/rodrigo/my-workspace/zephyr/soc/intel/wildcat_lake/Kconfig"
osource "/home/rodrigo/my-workspace/zephyr/soc/intel/raptor_lake/Kconfig"
osource "/home/rodrigo/my-workspace/zephyr/soc/intel/panther_lake/Kconfig"
osource "/home/rodrigo/my-workspace/zephyr/soc/intel/lakemont/Kconfig"
osource "/home/rodrigo/my-workspace/zephyr/soc/intel/intel_socfpga_std/Kconfig"
osource "/home/rodrigo/my-workspace/zephyr/soc/intel/intel_socfpga/Kconfig"
osource "/home/rodrigo/my-workspace/zephyr/soc/intel/intel_niosv/Kconfig"
osource "/home/rodrigo/my-workspace/zephyr/soc/intel/intel_ish/Kconfig"
osource "/home/rodrigo/my-workspace/zephyr/soc/intel/intel_adsp/Kconfig"
osource "/home/rodrigo/my-workspace/zephyr/soc/intel/elkhart_lake/Kconfig"
osource "/home/rodrigo/my-workspace/zephyr/soc/intel/atom/Kconfig"
osource "/home/rodrigo/my-workspace/zephyr/soc/intel/apollo_lake/Kconfig"
osource "/home/rodrigo/my-workspace/zephyr/soc/intel/alder_lake/Kconfig"
osource "/home/rodrigo/my-workspace/zephyr/soc/infineon/psoc4/Kconfig"
osource "/home/rodrigo/my-workspace/zephyr/soc/infineon/edge/Kconfig"
osource "/home/rodrigo/my-workspace/zephyr/soc/infineon/cat3/Kconfig"
osource "/home/rodrigo/my-workspace/zephyr/soc/infineon/cat1c/Kconfig"
osource "/home/rodrigo/my-workspace/zephyr/soc/infineon/cat1b/Kconfig"
osource "/home/rodrigo/my-workspace/zephyr/soc/infineon/cat1a/Kconfig"
osource "/home/rodrigo/my-workspace/zephyr/soc/gd/gd32/Kconfig"
osource "/home/rodrigo/my-workspace/zephyr/soc/gaisler/leon3/Kconfig"
osource "/home/rodrigo/my-workspace/zephyr/soc/gaisler/gr716a/Kconfig"
osource "/home/rodrigo/my-workspace/zephyr/soc/focaltech/Kconfig"
osource "/home/rodrigo/my-workspace/zephyr/soc/espressif/Kconfig"
osource "/home/rodrigo/my-workspace/zephyr/soc/ene/kb1200/Kconfig"
osource "/home/rodrigo/my-workspace/zephyr/soc/ene/kb106x/Kconfig"
osource "/home/rodrigo/my-workspace/zephyr/soc/elan/em32f967/Kconfig"
osource "/home/rodrigo/my-workspace/zephyr/soc/egis/Kconfig"
osource "/home/rodrigo/my-workspace/zephyr/soc/efinix/sapphire/Kconfig"
osource "/home/rodrigo/my-workspace/zephyr/soc/cdns/xtensa_sample_controller/Kconfig"
osource "/home/rodrigo/my-workspace/zephyr/soc/cdns/swerv/Kconfig"
osource "/home/rodrigo/my-workspace/zephyr/soc/cdns/sample_controller32/Kconfig"
osource "/home/rodrigo/my-workspace/zephyr/soc/cdns/dc233c/Kconfig"
osource "/home/rodrigo/my-workspace/zephyr/soc/brcm/bcmvk/Kconfig"
osource "/home/rodrigo/my-workspace/zephyr/soc/brcm/bcm2712/Kconfig"
osource "/home/rodrigo/my-workspace/zephyr/soc/brcm/bcm2711/Kconfig"
osource "/home/rodrigo/my-workspace/zephyr/soc/blackberry/qnxhv_vm/Kconfig"
osource "/home/rodrigo/my-workspace/zephyr/soc/bflb/Kconfig"
osource "/home/rodrigo/my-workspace/zephyr/soc/atmel/sam0/Kconfig"
osource "/home/rodrigo/my-workspace/zephyr/soc/atmel/sam/Kconfig"
osource "/home/rodrigo/my-workspace/zephyr/soc/aspeed/Kconfig"
osource "/home/rodrigo/my-workspace/zephyr/soc/arm/Kconfig"
osource "/home/rodrigo/my-workspace/zephyr/soc/arm/beetle/Kconfig"
osource "/home/rodrigo/my-workspace/zephyr/soc/antmicro/myra/Kconfig"
osource "/home/rodrigo/my-workspace/zephyr/soc/andestech/Kconfig"
osource "/home/rodrigo/my-workspace/zephyr/soc/amd/acp_7_x/Kconfig"
osource "/home/rodrigo/my-workspace/zephyr/soc/amd/acp_7_0/Kconfig"
osource "/home/rodrigo/my-workspace/zephyr/soc/amd/acp_6_0/Kconfig"
osource "/home/rodrigo/my-workspace/zephyr/soc/ambiq/Kconfig"
osource "/home/rodrigo/my-workspace/zephyr/soc/allwinner/sun8i_h3/Kconfig"
osource "/home/rodrigo/my-workspace/zephyr/soc/allwinner/sun50i_h618/Kconfig"
osource "/home/rodrigo/my-workspace/zephyr/soc/alif/ensemble/Kconfig"
osource "/home/rodrigo/my-workspace/zephyr/soc/alif/balletto/Kconfig"
osource "/home/rodrigo/my-workspace/zephyr/soc/aesc/Kconfig"
osource "/home/rodrigo/my-workspace/zephyr/soc/adi/max32/Kconfig"
```
